/*  -- CONTROLAR TV DE CASA --
 * Autor: Matheus Dias
 * Início: 14/02/2018 
 * Last_Att: 25/02/2018
 * Utilidade: Ligar/Desligar e Aumentar/Diminuir Volume da televisão;
 * O Led Emissor IR deve estar ligado ao pino Digital 3;
 */

#include <IRremote.h>

IRsend irsend;

void ligar_desligar();   // Para ligar o comando é: 'l'
void aumentar_volume();  // Para aumentar o volume é: 'u'
void diminuir_volume();  // Para diminuir o volume é: 'd'


int khz = 38; // 38kHz carrier frequency for the NEC protocol

void setup()
{
  Serial.begin(38400);

}

void loop() {
  if (Serial.available()){
    char cmd = Serial.read(); // lê o valor digitado e enviado pela serial monitor.

    if (cmd == 'l'){
      Serial.println("Ligar");
      ligar();
      delay(100);
      cmd = 0;
    }
      if (cmd == 'o'){
      Serial.println("Desligar");
      desligar();
      delay(100);
      cmd = 0;
    }
    else if (cmd == 'u'){
      Serial.println("Aumentar Volume!"); 
      aumentar_volume();
      delay(100);
      cmd = 0;
    }
    else if (cmd == 'd'){
      Serial.println("Diminuir Volume!"); 
      diminuir_volume();
      delay(100);
      cmd = 0;
    }

  }
  
 }//Fim_loop();

void ligar(){  
  //unsigned int irSignal[] = {8388, 4252, 620, 1636, 592, 508, 556, 604, 556, 528, 592, 1636, 596,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 1632, 588}; //AnalysIR Batch Export (IRremote) - RAW
  //TV Casa - Ativo
  unsigned int irSignal[] = {8916, 4472, 556, 596, 528, 596, 532, 1728, 512, 592, 532, 608, 520,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 2268, 536}; //AnalysIR Batch Export (IRremote) - RAW
  irsend.sendRaw(irSignal, sizeof(irSignal) / sizeof(irSignal[0]), khz); //Note the approach used to automatically calculate the size of the array.
}//Fim_ligar_desligar();

void desligar(){  
  //unsigned int irSignal[] = {8336, 4280, 508, 1744, 480, 676, 452, 648, 476, 648, 452, 1740, 512,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 1736, 488}; //AnalysIR Batch Export (IRremote) - RAW
  unsigned int irSignal[] = {8336, 4280, 508, 1744, 480, 676, 452, 648, 476, 648, 452, 1740, 512,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 1736, 488}; //AnalysIR Batch Export (IRremote) - RAW
  irsend.sendRaw(irSignal, sizeof(irSignal) / sizeof(irSignal[0]), khz); //Note the approach used to automatically calculate the size of the array.
}//Fim_ligar_desligar();



void aumentar_volume(){  
  unsigned int irSignal[] = {8960, 4456, 572, 556, 572, 552, 572, 1668, 572, 556, 572, 556, 572,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 572, 30208}; //AnalysIR Batch Export (IRremote) - RAW
  irsend.sendRaw(irSignal, sizeof(irSignal) / sizeof(irSignal[0]), khz); //Note the approach used to automatically calculate the size of the array.
}//Fim_aumentar_volume();

void diminuir_volume(){  
  unsigned int irSignal[] = {8916, 4500, 528, 596, 532, 592, 532, 1716, 524, 604, 524, 596, 532,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 2292, 508}; //AnalysIR Batch Export (IRremote) - RAW
  irsend.sendRaw(irSignal, sizeof(irSignal) / sizeof(irSignal[0]), khz); //Note the approach used to automatically calculate the size of the array.
}//Fim_diminur_volume();




//-----------// TV LG - CASA --- //-----------//

// ON TV: Raw: (179) 8916, 4472, 556, 596, 528, 596, 532, 1728, 512, 592, 532, 608, 520,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 536, 

// VOLUME UP: Raw: (87) 8960, 4456, 572, 556, 572, 552, 572, 1668, 572, 556, 572, 556, 572,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 572, 

// VULUME DOWN: Raw: (75) 8916, 4500, 528, 596, 532, 592, 532, 1716, 524, 604, 524, 596, 532,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 508, 

//-------------// TV LG - CASA --- //-----------------


//-----------// CENTRAL DE AR SALA 5 (GREE) --- //-------------
// ON : Raw: (139) 8908, 4516, 604, 1676, 616, 588, 612, 588, 612, 608, 592, 1700, 592,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 612, 

// VOLUME UP: Raw: (139) 8880, 4512, 608, 1724, 568, 596, 604, 592, 608, 1692, 600, 1724, 568,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 652, 

// VOLUME DOWN: Raw: (139) 8880, 4552, 568, 1696, 596, 632, 568, 632, 564, 1728, 568, 1728, 564,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 628, 
//----------// CENTRAL DE AR SALA 5 (GREE) --- //------------
